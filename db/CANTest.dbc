VERSION ""

NS_ :

BS_:

BU_:

BO_ 3221225472 VECTOR__INDEPENDENT_SIG_MSG: 0 Vector__XXX
 SG_ Double_Signa_Motoroall_3 : 0|64@0- (1,0) [0|0] "m" Vector__XXX

BO_ 51 TESTMessage: 8 Vector__XXX

BO_ 37 Message1: 6 Vector__XXX
 SG_ FloatSignal : 16|32@1- (1.5,2) [-5.1E+038|5.1E+038] "" Vector__XXX
 SG_ UNSIGNEDINTSignal : 0|16@1+ (1,0) [0|65535] "km/h" Vector__XXX

CM_ BO_ 3221225472 "This is a message for not used signals, created by Vector CANdb++ DBC OLE DB Provider.";
BA_DEF_  "BusType" STRING ;
BA_DEF_DEF_  "BusType" "CAN";
SIG_VALTYPE_ 3221225472 Double_Signa_Motoroall_3 : 2;
SIG_VALTYPE_ 37 FloatSignal : 1;
